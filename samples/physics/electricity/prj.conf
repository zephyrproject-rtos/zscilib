## CMakeLists.txt
```
cmake_minimum_required(VERSION 3.13.1)
include($ENV{ZEPHYR_BASE}/cmake/app/boilerplate.cmake NO_POLICY_SCOPE)
project(electricity)

target_sources(app PRIVATE src/main.c)
```

## sample.yaml
```
sample:
  name: zscilib electricity example
tests:
  test:
    tags: zscilib
    # The filters below are from DTS
    filter: LED0_GPIO_CONTROLLER
    depends_on: gpio
```

## prj.conf
```kconfig
CONFIG_STDOUT_CONSOLE=y
CONFIG_SERIAL=y
CONFIG_FPU=y
CONFIG_TEST=y
CONFIG_THREAD_RUNTIME_STATS=y
CONFIG_NEWLIB_LIBC=y
CONFIG_NEWLIB_LIBC_FLOAT_PRINTF=y

CONFIG_ZSL=y
CONFIG_ZSL_PLATFORM_OPT=2
CONFIG_ZSL_SINGLE_PRECISION=n
CONFIG_ZSL_VECTOR_INLINE=n
CONFIG_ZSL_MATRIX_INLINE=n
CONFIG_ZSL_BOUNDS_CHECKS=y
```

## src/main.c
```c
/*
 * Copyright (c) 2019 Kevin Townsend
 *
 * SPDX-License-Identifier: Apache-2.0
 */

#include <stdio.h>
#include <math.h>
#include <errno.h>
#include <kernel.h>
#include <zephyr.h>
#include <zsl/zsl.h>
#include <zsl/physics/electricity.h>

void electricity_demo(void)
{
	printf("Physics electricity API demo\n");
	printf("----------------------------\n\n");

	zsl_real_t c;

	ZSL_VECTOR_DEF(va, 5);

	zsl_real_t a[5] = { 1.0, 3.2, 4.0, 0.5, 3.5 };

	zsl_vec_from_arr(&va, a);

	zsl_phy_elcty_cap_series(&va, &c);

	zsl_vec_print(&va);

	printf("Val is: %f\n", c);
}

void main(void)
{
	printf("\n\nzscilib electricity demo\n\n");

	electricity_demo();
}
```
